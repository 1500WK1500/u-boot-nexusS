## board/samsung/nexuss/Kconfig
```kconfig
if TARGET_S5P_NEXUSS

config SYS_BOARD
	default "nexuss"

config SYS_VENDOR
	default "samsung"

config SYS_SOC
	default "s5pc1xx"

config SYS_CONFIG_NAME
	default "s5p_nexuss"

endif
```
